## release/src-mtk-MT798X/Uboot-upstream/tools/build_mtk/uboot.its
```
/dts-v1/;

/ {
	description = "MT7986 boot FIT";

	images {
		kernel-1 {
			description = "BL2";
			data = /incbin/("./bl2.img");
			type = "kernel";
			arch = "arm64";
			os = "linux";
			compression = "none";
			hash-1 {
				algo = "sha1";
			};
		};
		kernel-2 {
			description = "FIP";
			data = /incbin/("fip.bin");
			type = "kernel";
			arch = "arm64";
			os = "linux";
			compression = "none";
			hash-1 {
				algo = "sha1";
			};
		};
	};
};
```

## release/src-mtk-MT798X/linux/linux-5.4.x/asus/Kconfig
```kconfig
choice
	prompt "Choose Product"
	help
	   Choose specific product for different hardware layout

config PANTHERA
	bool "Panther porting on PantherA RFB"

config PANTHERB
	bool "Panther porting on PantherB RFB"

config CHEETAH
	bool "Cheetah porting on Cheetah RFB"

config TUFAX4200
	bool "Panther TUF-AX4200/TUF-AX4200Q"

config TUFAX6000
	bool "Panther TUF-AX6000"

config RTAX59U
	bool "Panther RT-AX59U"

endchoice
```

## release/src-mtk-MT798X/linux/linux-5.4.x/drivers/nvram/Kconfig
```kconfig
menu "ASUS NVRAM"

config	ASUS_NVRAM_API
	tristate "ASUS NVRAM R/W API"
	default m
	---help---
	ASUS NVRAM R/W API

config NVRAM_SIZE
	hex "Specify nvram size on MT798X platform "
	depends on ASUS_NVRAM_API
	default 0x10000

endmenu
```
